/* Copyright (c) 2013-2014, The Linux Foundation. All rights reserved.
 *
 * This program is free software; you can redistribute it and/or modify
 * it under the terms of the GNU General Public License version 2 and
 * only version 2 as published by the Free Software Foundation.
 *
 * This program is distributed in the hope that it will be useful,
 * but WITHOUT ANY WARRANTY; without even the implied warranty of
 * MERCHANTABILITY or FITNESS FOR A PARTICULAR PURPOSE.  See the
 * GNU General Public License for more details.
 */

qcom,palladium-batterydata {
	qcom,fcc-mah = <2500>;
	qcom,default-rbatt-mohm = <179>;
	qcom,rbatt-capacitive-mohm = <0>;
	qcom,flat-ocv-threshold-uv = <3800000>;
	qcom,max-voltage-uv = <4350000>;
	qcom,v-cutoff-uv = <3400000>;
	qcom,chg-term-ua = <100000>;
	qcom,batt-id-kohm = <75>;
	qcom,battery-type = "hmct_bk_wk_2500mah";

	qcom,rbatt-sf-lut {
		qcom,lut-col-legend = <(-20) 0 25 40 60>;
		qcom,lut-row-legend = <100 95 90 85 80>,
				<75 70 65 60 55>,
				<50 45 40 35 30>,
				<25 20 16 13 11>,
				<10 9 8 7 6>,
				<5 4 3 2 1>,
				<0>;
		qcom,lut-data = <917 253 100 84 83>,
				<903 253 100 85 83>,
				<800 250 100 85 83>,
				<750 222 102 87 84>,
				<708 255 106 89 87>,
				<695 256 109 92 88>,
				<696 242 112 95 87>,
				<704 247 108 98 89>,
				<721 251 99 87 82>,
				<743 263 98 85 80>,
				<772 280 100 86 81>,
				<805 304 103 89 83>,
				<896 333 107 91 85>,
				<1056 366 110 92 87>,
				<1316 400 112 92 83>,
				<1775 441 116 89 83>,
				<2160 493 120 90 82>,
				<2300 552 127 90 82>,
				<2200 562 130 90 82>,
				<2300 572 132 91 83>,
				<2480 578 135 91 83>,
				<2600 604 140 93 84>,
				<2850 616 145 94 85>,
				<3300 640 147 95 86>,
				<4000 678 149 93 84>,
				<4200 721 158 92 83>,
				<4300 812 167 93 83>,
				<4618 967 179 95 85>,
				<5718 1266 196 103 90>,
				<6918 1512 225 110 108>,
				<8000 1736 295 139 114>;
	};

	qcom,fcc-temp-lut {
		qcom,lut-col-legend = <(-20) 0 25 40 60>;
		qcom,lut-data = <2500 2581 2558 2576 2544>;
	};

	qcom,pc-temp-ocv-lut {
		qcom,lut-col-legend = <(-20) 0 25 40 60>;
		qcom,lut-row-legend = <100 95 90 85 80>,
				<75 70 65 60 55>,
				<50 45 40 35 30>,
				<25 20 16 13 11>,
				<10 9 8 7 6>,
				<5 4 3 2 1>,
				<0>;
		qcom,lut-data = <4319 4320 4320 4317 4312>,
				<4202 4246 4258 4257 4253>,
				<4125 4189 4204 4202 4199>,
				<4076 4135 4151 4149 4147>,
				<4014 4080 4101 4098 4096>,
				<3930 4033 4057 4051 4048>,
				<3885 3952 3994 3999 4003>,
				<3845 3914 3955 3965 3963>,
				<3817 3884 3908 3921 3921>,
				<3798 3853 3869 3871 3872>,
				<3781 3823 3841 3842 3841>,
				<3765 3798 3818 3818 3818>,
				<3748 3778 3799 3799 3799>,
				<3731 3763 3782 3783 3782>,
				<3713 3749 3768 3769 3761>,
				<3693 3734 3755 3752 3737>,
				<3665 3721 3734 3729 3713>,
				<3638 3712 3711 3701 3693>,
				<3608 3702 3697 3689 3679>,
				<3585 3695 3690 3683 3673>,
				<3574 3690 3687 3680 3668>,
				<3556 3684 3685 3679 3666>,
				<3533 3676 3684 3677 3665>,
				<3502 3665 3681 3675 3660>,
				<3458 3646 3671 3666 3640>,
				<3391 3615 3641 3633 3600>,
				<3343 3564 3588 3580 3542>,
				<3271 3488 3515 3509 3465>,
				<3194 3363 3409 3411 3359>,
				<3035 3196 3240 3250 3187>,
				<3000 3000 3000 3000 3000>;
	};
};
