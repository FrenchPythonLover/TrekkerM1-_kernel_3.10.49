## drivers/input/touchscreen/goodix/Kconfig
```kconfig
#
# Goodix GT9xx Touchscreen driver
#
config HIS_TOUCHSCREEN_GOODIX_GESTURE
	tristate "Goodix touchpanel for gesture"
	depends on HIS_TOUCHSCREEN_GOODIX
	default n
	help
	  This is application debug interface support for Goodix GT9xx
	  touchscreens.

	  Say Y here if you want to have a Android app debug interface
	  to your system.

	  If unsure, say N.
config HIS_TOUCHSCREEN_GOODIX_AUTO_UPDATE
	bool "Goodix touchpanel auto update "
	depends on HIS_TOUCHSCREEN_GOODIX
	default n
	help
		Say Y here to enable Touchscreen factory test functions.
		
		If unsure, say N.
```

## drivers/sensors/HS_SNS_DRV/Kconfig
```kconfig
#
# hisense sensors device configuration
#

menu "Hisense sensors device support"
	depends on SENSORS

config HS_SNS_ACC
	bool "Provide Accelerometer Device Support"
	default n
	depends on SENSORS
	help
	  Say Y here, a list of availible accelerometer chips shall be shown.
	  Then you can select one or more chip for one project.
	
if HS_SNS_ACC

config HS_SNS_BMA2X2
	bool "Bosch bma2x2 serial Acc chips"
	default n
	help
	 Say y here if you want to use Bosch bma2x2 acc chip.

config HS_SNS_KXTJ9
	bool "Kionix kxt* serial Acc chips"
	default n
	help
	 Say y here if you want to use Kionix kxtj9 kxtj2 kxtik1004 acc chips.

config HS_SNS_MC3XXX
	bool "mCube mc3xxx serial Acc chips"
	default n
	help
	 Say y here if you want to use mCube mc3xxx serial acc chips.

endif

config HS_SNS_MAG
	bool "Provide Magnetic Device Support"
	default n
	depends on HS_SNS_ACC
	help
	  Say Y here, a list of availible Magnetic chips shall be shown.
	  Then you can select one or more chip for one project.
	
if HS_SNS_MAG

config HS_SNS_AKM09911
	bool "AKM akm09911 Mag chips"
	default n
	help
	 Say y here if you want to use AKM akm09911 Mag chips.

config HS_SNS_AKM09916
	bool "AKM akm09916 Mag chips"
	default n
	help
	 Say y here if you want to use AKM akm09916 Mag chips.

config HS_SNS_ST480
	bool "SENODIA st480 Mag chips"
	default n
	help
	 Say y here if you want to use SENODIA st480 Mag chips.

endif

config HS_SNS_GYRO
	bool "Provide Gyroscope Device Support"
	default n
	depends on HS_SNS_ACC
	help
	  Say Y here, a list of availible Gyroscope chips shall be shown.
	  Then you can select one or more chip for one project.
	
if HS_SNS_GYRO

config HS_SNS_MPU3050
	bool "InvenSense MPU3050 Gyro chips"
	default n
	depends on !HS_SNS_MPU6050
	help
	 Say y here if you want to use InvenSense MPU3050 serial Gyro chips.

comment "MPU6050 is a Acc + Gyro combo chip, so not need to say y here while it seleted in Acc"

endif

config HS_SNS_ALSPS
	bool "Provide Ambient Light and/or Proximity Device Support"
	default n
	depends on SENSORS
	help
	  Say Y here, a list of availible Ambient Light and/or Proximity chips shall be shown.
	  Then you can select only one chip for one project.
	
if HS_SNS_ALSPS

config HS_SNS_APDS993X
	bool "Avago apds993x alsps chips"
	help
	 Say y here if you want to use Avago apds993x alsps chips.

config HS_SNS_CM36686
	bool "Capella cm36686 alsps chips"
	help
	 Say y here if you want to use Capella cm36686 alsps chips.

config HS_SNS_ELAN_ALSPS
	bool "Elan epl2590/epl88055 alsps chips"
	default n
	help
	 Say y here if you want to use Elan epl2590/epl88055 alsps chips.


endif

endmenu
```

## drivers/soc/hisense/Kconfig
```kconfig
config MACH_HISENSE_SMARTPHONE
	default n
	bool "HISENSE SMARTPHONE"
	help
	  Support for the hisense samrtphone board.

config HISENSE_VENDOR_NAME
	depends on MACH_HISENSE_SMARTPHONE
	string "Hisense vendor info"
	default ""
	help
	  The vendor name of product.

config HISENSE_PRODUCT_NAME
	depends on MACH_HISENSE_SMARTPHONE
	string "Hisense product info"
	default ""
	help
	  The product name.

config HISENSE_PRODUCT_DEVINFO
	depends on MACH_HISENSE_SMARTPHONE
	bool "device info register of product"
	help
	  Provide a methed to register the peripheral device
	  infomation of product.

config HISENSE_BOOT_INFO
	bool "Hisense Boot information"
	depends on MACH_HISENSE_SMARTPHONE
	default n
	help
	  The information of booting system.

config HISENSE_USB_FEATURE
	bool "enable hisense usb feature"
	depends on MACH_HISENSE_SMARTPHONE
	default y
	help
		Enable the config if enable hisense usb feature .
		If unsure, say N
```
